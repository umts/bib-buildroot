## Config.in
```kconfig
if BR2_TARGET_ROOTFS_ISO9660_HYBRID

config BUS_INFO_BOARD_ROOTFS_ISO9660_HYBRID_INITRD_SHIM
	bool "Build a mini initrd to help find the rootfs"
	select BR2_TARGET_ROOTFS_ISO9660_INITRD
	help
	  Enabling this option will build a small initrd in order to
	  find the actual root filesystem. This is necessary for a
	  "hybrid" image to work regardless of the device its written
	  to. Alternatively, you can select BR2_TARGET_ROOTFS_ISO9660_INITRD
	  directly which will make the entire root filesystem your
	  initrd.

endif
```

## configs/lcdbib_defconfig
```kconfig
BR2_x86_i686=y
BR2_CCACHE=y
BR2_CCACHE_DIR="../buildroot-ccache"
BR2_TOOLCHAIN_BUILDROOT_GLIBC=y
BR2_KERNEL_HEADERS_4_8=y
BR2_GLIBC_VERSION_2_24=y
BR2_BINUTILS_VERSION_2_27_X=y
BR2_TOOLCHAIN_BUILDROOT_CXX=y
BR2_ROOTFS_MERGED_USR=y
BR2_INIT_SYSV=y
BR2_ROOTFS_DEVICE_CREATION_DYNAMIC_EUDEV=y
BR2_ROOTFS_DEVICE_TABLE="system/device_table.txt $(BR2_EXTERNAL_BUS_INFO_BOARD_PATH)/board/shared/device_table"
# BR2_TARGET_GENERIC_GETTY is not set
# BR2_TARGET_GENERIC_REMOUNT_ROOTFS_RW is not set
BR2_SYSTEM_DHCP="eth0"
BR2_ROOTFS_USERS_TABLES="$(BR2_EXTERNAL_BUS_INFO_BOARD_PATH)/board/shared/user_table"
BR2_ROOTFS_OVERLAY="$(BR2_EXTERNAL_BUS_INFO_BOARD_PATH)/board/shared/rootfs_overlay $(BR2_EXTERNAL_BUS_INFO_BOARD_PATH)/board/livecd/rootfs_overlay"
BR2_ROOTFS_POST_IMAGE_SCRIPT="$(BR2_EXTERNAL_BUS_INFO_BOARD_PATH)/board/livecd/post-image.sh"
BR2_LINUX_KERNEL=y
BR2_LINUX_KERNEL_USE_CUSTOM_CONFIG=y
BR2_LINUX_KERNEL_CUSTOM_CONFIG_FILE="$(BR2_EXTERNAL_BUS_INFO_BOARD_PATH)/board/livecd/linux.config"
BR2_PACKAGE_MESA3D=y
BR2_PACKAGE_MESA3D_DRI_DRIVER_SWRAST=y
BR2_PACKAGE_MESA3D_DRI_DRIVER_I915=y
BR2_PACKAGE_MESA3D_DRI_DRIVER_I965=y
BR2_PACKAGE_MESA3D_DRI_DRIVER_NOUVEAU=y
BR2_PACKAGE_MESA3D_OPENGL_EGL=y
BR2_PACKAGE_XORG7=y
BR2_PACKAGE_XSERVER_XORG_SERVER=y
BR2_PACKAGE_XAPP_XINIT=y
BR2_PACKAGE_XAPP_XSET=y
BR2_PACKAGE_XDRIVER_XF86_INPUT_EVDEV=y
BR2_PACKAGE_XDRIVER_XF86_INPUT_KEYBOARD=y
BR2_PACKAGE_XDRIVER_XF86_INPUT_MOUSE=y
BR2_PACKAGE_XDRIVER_XF86_INPUT_VMMOUSE=y
BR2_PACKAGE_XDRIVER_XF86_VIDEO_ATI=y
BR2_PACKAGE_XDRIVER_XF86_VIDEO_FBDEV=y
BR2_PACKAGE_XDRIVER_XF86_VIDEO_INTEL=y
BR2_PACKAGE_XDRIVER_XF86_VIDEO_NV=y
BR2_PACKAGE_XDRIVER_XF86_VIDEO_VESA=y
BR2_PACKAGE_XCURSOR_TRANSPARENT_THEME=y
BR2_PACKAGE_MIDORI=y
BR2_PACKAGE_XTERM=y
BR2_PACKAGE_MATCHBOX=y
BR2_PACKAGE_USBMOUNT=y
BR2_PACKAGE_RUBY=y
BR2_PACKAGE_LIBGTK3=y
# BR2_PACKAGE_LIBGTK3_BROADWAY is not set
# BR2_PACKAGE_LIBGTK3_WAYLAND is not set
BR2_PACKAGE_NTP=y
BR2_PACKAGE_UTIL_LINUX_BINARIES=y
BR2_PACKAGE_UTIL_LINUX_AGETTY=y
BR2_TARGET_ROOTFS_ISO9660=y
BR2_TARGET_ROOTFS_ISO9660_BOOT_MENU="$(BR2_EXTERNAL_BUS_INFO_BOARD_PATH)/board/livecd/menu.lst"
# BR2_TARGET_ROOTFS_ISO9660_INITRD is not set
# BR2_TARGET_ROOTFS_TAR is not set
BR2_TARGET_GRUB=y
# BR2_TARGET_GRUB_FS_EXT2 is not set
# BR2_TARGET_GRUB_FS_FAT is not set
```

## configs/rpibib_defconfig
```kconfig
BR2_arm=y
BR2_arm1176jzf_s=y
BR2_PACKAGE_HOST_LINUX_HEADERS_CUSTOM_4_1=y
BR2_TOOLCHAIN_BUILDROOT_WCHAR=y
# BR2_UCLIBC_INSTALL_UTILS is not set
BR2_TOOLCHAIN_BUILDROOT_CXX=y
BR2_INIT_SYSV=y
BR2_ROOTFS_DEVICE_CREATION_DYNAMIC_EUDEV=y
BR2_ROOTFS_DEVICE_TABLE="system/device_table.txt $(BR2_EXTERNAL)/board/shared/device_table"
BR2_SYSTEM_DHCP="eth0"
# BR2_TARGET_GENERIC_GETTY is not set
BR2_ROOTFS_USERS_TABLES="$(BR2_EXTERNAL)/board/shared/user_table"
BR2_ROOTFS_OVERLAY="$(BR2_EXTERNAL)/board/shared/rootfs_overlay"
BR2_ROOTFS_POST_IMAGE_SCRIPT="board/raspberrypi/post-image.sh"
BR2_LINUX_KERNEL=y
BR2_LINUX_KERNEL_CUSTOM_GIT=y
BR2_LINUX_KERNEL_CUSTOM_REPO_URL="https://github.com/raspberrypi/linux.git"
BR2_LINUX_KERNEL_CUSTOM_REPO_VERSION="d33d0293e245badc4ca6ede3984d8bb8ea63cb1a"
BR2_LINUX_KERNEL_DEFCONFIG="bcmrpi"
BR2_LINUX_KERNEL_ZIMAGE=y
BR2_LINUX_KERNEL_DTS_SUPPORT=y
BR2_LINUX_KERNEL_INTREE_DTS_NAME="bcm2708-rpi-b bcm2708-rpi-b-plus bcm2708-rpi-cm"
BR2_PACKAGE_XORG7=y
BR2_PACKAGE_XSERVER_XORG_SERVER=y
BR2_PACKAGE_XAPP_XINIT=y
BR2_PACKAGE_XAPP_XSET=y
BR2_PACKAGE_XDRIVER_XF86_INPUT_EVDEV=y
BR2_PACKAGE_XDRIVER_XF86_INPUT_KEYBOARD=y
BR2_PACKAGE_XDRIVER_XF86_INPUT_MOUSE=y
BR2_PACKAGE_XDRIVER_XF86_VIDEO_FBDEV=y
BR2_PACKAGE_XDRIVER_XF86_VIDEO_VESA=y
BR2_PACKAGE_XCURSOR_TRANSPARENT_THEME=y
BR2_PACKAGE_MIDORI=y
BR2_PACKAGE_XTERM=y
BR2_PACKAGE_MATCHBOX=y
BR2_PACKAGE_RPI_FIRMWARE=y
BR2_PACKAGE_RUBY=y
# BR2_PACKAGE_RPI_FIRMWARE_INSTALL_DTB_OVERLAYS is not set
BR2_PACKAGE_LIBGTK2=y
BR2_PACKAGE_UTIL_LINUX_BINARIES=y
BR2_PACKAGE_UTIL_LINUX_AGETTY=y
BR2_TARGET_ROOTFS_CPIO=y
BR2_TARGET_ROOTFS_CPIO_GZIP=y
BR2_TARGET_ROOTFS_CPIO_UIMAGE=y
BR2_TARGET_ROOTFS_EXT2=y
BR2_TARGET_ROOTFS_EXT2_4=y
# BR2_TARGET_ROOTFS_TAR is not set
BR2_TARGET_UBOOT=y
BR2_TARGET_UBOOT_BUILD_SYSTEM_KCONFIG=y
BR2_TARGET_UBOOT_BOARD_DEFCONFIG="rpi"
BR2_PACKAGE_HOST_DOSFSTOOLS=y
BR2_PACKAGE_HOST_GENIMAGE=y
BR2_PACKAGE_HOST_MTOOLS=y
```

## configs/rpibib_net_defconfig
```kconfig
BR2_arm=y
BR2_arm1176jzf_s=y
BR2_CCACHE=y
BR2_CCACHE_DIR="$(TOPDIR)/../buildroot-ccache"
BR2_TOOLCHAIN_BUILDROOT_GLIBC=y
BR2_KERNEL_HEADERS_4_4=y
BR2_GLIBC_VERSION_2_24=y
BR2_BINUTILS_VERSION_2_27_X=y
BR2_TOOLCHAIN_BUILDROOT_CXX=y
BR2_ROOTFS_MERGED_USR=y
BR2_INIT_SYSV=y
BR2_ROOTFS_DEVICE_CREATION_DYNAMIC_EUDEV=y
BR2_ROOTFS_DEVICE_TABLE="system/device_table.txt $(BR2_EXTERNAL_BUS_INFO_BOARD_PATH)/board/shared/device_table"
# BR2_TARGET_GENERIC_GETTY is not set
BR2_SYSTEM_DHCP="eth0"
BR2_ROOTFS_USERS_TABLES="$(BR2_EXTERNAL_BUS_INFO_BOARD_PATH)/board/shared/user_table"
BR2_ROOTFS_OVERLAY="$(BR2_EXTERNAL_BUS_INFO_BOARD_PATH)/board/shared/rootfs_overlay $(BR2_EXTERNAL)/board/raspberrypi/rootfs_overlay"
BR2_ROOTFS_POST_BUILD_SCRIPT="$(BR2_EXTERNAL_BUS_INFO_BOARD_PATH)/board/raspberrypi/post-build.sh"
BR2_ROOTFS_POST_IMAGE_SCRIPT="$(BR2_EXTERNAL_BUS_INFO_BOARD_PATH)/board/raspberrypi/post-image-net.sh"
BR2_LINUX_KERNEL=y
BR2_LINUX_KERNEL_CUSTOM_GIT=y
BR2_LINUX_KERNEL_CUSTOM_REPO_URL="https://github.com/raspberrypi/linux.git"
BR2_LINUX_KERNEL_CUSTOM_REPO_VERSION="9669a50a3a8e4f33b4fe138277bc4407e1eab9b2 "
BR2_LINUX_KERNEL_USE_CUSTOM_CONFIG=y
BR2_LINUX_KERNEL_CUSTOM_CONFIG_FILE="$(BR2_EXTERNAL_BUS_INFO_BOARD_PATH)/board/raspberrypi/linux.config"
BR2_LINUX_KERNEL_DTS_SUPPORT=y
BR2_LINUX_KERNEL_INTREE_DTS_NAME="bcm2708-rpi-b bcm2708-rpi-b-plus bcm2708-rpi-cm"
BR2_PACKAGE_MESA3D=y
BR2_PACKAGE_MESA3D_DRI_DRIVER_SWRAST=y
BR2_PACKAGE_MESA3D_OPENGL_EGL=y
BR2_PACKAGE_XORG7=y
BR2_PACKAGE_XSERVER_XORG_SERVER=y
BR2_PACKAGE_XAPP_XINIT=y
BR2_PACKAGE_XAPP_XSET=y
BR2_PACKAGE_XDRIVER_XF86_INPUT_EVDEV=y
BR2_PACKAGE_XDRIVER_XF86_INPUT_KEYBOARD=y
BR2_PACKAGE_XDRIVER_XF86_INPUT_MOUSE=y
BR2_PACKAGE_XDRIVER_XF86_VIDEO_FBDEV=y
BR2_PACKAGE_XDRIVER_XF86_VIDEO_VESA=y
BR2_PACKAGE_XCURSOR_TRANSPARENT_THEME=y
BR2_PACKAGE_MIDORI=y
BR2_PACKAGE_XTERM=y
BR2_PACKAGE_MATCHBOX=y
BR2_PACKAGE_RPI_FIRMWARE=y
# BR2_PACKAGE_RPI_FIRMWARE_INSTALL_DTB_OVERLAYS is not set
BR2_PACKAGE_RUBY=y
BR2_PACKAGE_LIBSHA1=y
BR2_PACKAGE_LIBGTK3=y
# BR2_PACKAGE_LIBGTK3_BROADWAY is not set
# BR2_PACKAGE_LIBGTK3_WAYLAND is not set
BR2_PACKAGE_LIBXKBCOMMON=y
BR2_PACKAGE_NTP=y
BR2_PACKAGE_UTIL_LINUX_BINARIES=y
BR2_PACKAGE_UTIL_LINUX_AGETTY=y
BR2_TARGET_ROOTFS_CPIO=y
BR2_TARGET_ROOTFS_CPIO_UIMAGE=y
# BR2_TARGET_ROOTFS_TAR is not set
BR2_TARGET_UBOOT=y
BR2_TARGET_UBOOT_BUILD_SYSTEM_KCONFIG=y
BR2_TARGET_UBOOT_BOARD_DEFCONFIG="rpi"
BR2_PACKAGE_HOST_DOSFSTOOLS=y
BR2_PACKAGE_HOST_GENIMAGE=y
BR2_PACKAGE_HOST_MKE2IMG=y
BR2_PACKAGE_HOST_MTOOLS=y
```

## package/nodm/Config.in
```kconfig
config BR2_PACKAGE_NODM
	bool "nodm"
	depends on BR2_PACKAGE_XORG7
	depends on BR2_USE_MMU #fork()
	depends on (BR2_ENABLE_LOCALE && BR2_USE_WCHAR) #pam
	depends on !BR2_STATIC_LIBS
	depends on !BR2_TOOLCHAIN_USES_MUSL
	select BR2_PACKAGE_LINUX_PAM
	select BR2_PACKAGE_XLIB_LIBX11
	help
	  nodm is a minimal display manager that simply logs in as a given user and
	  starts an X session, without asking for username or password.
	  
	  On a normal computer, using nodm is a big security issue because it would
	  give anyone access to the computer.
	  
	  However, there are cases where automatic login is needed: for example in
	  an embedded system such as a mobile phone, or in a kiosk setup, or in a
	  control panel for industrial machinery. For those cases, nodm is simple to
	  setup, lightweight, and it should do exactly the right thing.

comment "nodm needs Xorg and a uClibc or (e)glibc toolchain w/ wchar, locale, dynamic library"
	depends on !(BR2_ENABLE_LOCALE && BR2_USE_WCHAR) \
		|| !BR2_PACKAGE_XORG7 \
		|| BR2_STATIC_LIBS || BR2_TOOLCHAIN_USES_MUSL
```
